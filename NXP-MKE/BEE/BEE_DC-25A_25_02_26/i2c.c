#include "MKE02Z4.h"                    // Device header
#include "main.h"
#include  "i2c.h"
#include "stdbool.h"

int i=0;

const unsigned char hom[]={   // Page 0
	    // Page 0 (Top 8 rows)
    0x00, 0x00, 0x00, 0x00, 0x00, 0x00, 0x00, 0x00,
    0x00,  0x80, 0xC0, 0xE0, 0xF0, 0xF8,0XFC ,0XFE,
    0xFF, 0xFE, 0xF8, 0XF0, 0XE0, 0xC0, 0x80, 0x00,
	  0x00, 0x00, 0x00, 0x00, 0x00, 0x00, 0x00, 0x00,

    // Page 1 (Rows 8–15)
    0x00, 0x00, 0x00, 0x00, 0x00, 0x00, 0x00, 0xFF,
    0xFF, 0xFF, 0xFF, 0xFF, 0xFF, 0xFF, 0xFF, 0xFF,
    0xFF, 0xFF, 0xFF, 0xFF, 0xFF, 0xFF, 0xFF, 0xFF,
    0xFF, 0x00, 0x00, 0x00, 0x00, 0x00, 0x00, 0x00,

    // Page 2 (Rows 16–23)
    0x00, 0x00, 0x00, 0x00, 0x00, 0x00, 0x00, 0xFF,
    0xFF, 0xFF, 0xFF, 0xFF, 0xFF, 0x00, 0x00, 0x00,
    0x00, 0x00, 0x00, 0x00, 0xFF, 0xFF, 0xFF, 0xFF,
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    0xFF, 0x00, 0x00, 0x00, 0x00, 0x00, 0x00, 0x00,
   
};
const unsigned char ASCII_16[] = {
0x0D, 0x00, 0x00, 0x00, 0x00, 0x00, 0x00, 0x00, 0x00, 0x00, 0x00, 0x00,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 0x00,  // Code for char  
        0x06, 0x00, 0x00, 0x00, 0x00, 0x00, 0x00, 0xFE, 0xCF, 0x01, 0xFE, 0xCF,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 0x00,  // Code for char !
        0x08, 0x00, 0x00, 0x00, 0x1F, 0x00, 0x00, 0x3F, 0x00, 0x00, 0x1F, 0x00, 0x00, 0x00, 0x00, 0x00, 0x1F, 0x00, 0x00, 0x3F, 0x00, 0x00, 0x1F, 0x00, 0x00, 0x00, 0x00, 0x00, 0x00, 0x00, 0x00, 0x00, 0x00, 0x00, 0x00, 0x00, 0x00, 0x00, 0x00, 0x00, 0x00, 0x00, 0x00, 0x00, 0x00, 0x00, 0x00, 0x00, 0x00, 0x00, 0x00, 0x00, 0x00, 0x00, 0x00, 0x00, 0x00, 0x00, 0x00, 0x00, 0x00, 0x00, 0x00, 0x00, 0x00, 0x00, 0x00, 0x00, 0x00, 0x00, 0x00, 0x00, 0x00,  // Code for char "
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        0x07, 0x00, 0x00, 0x00, 0xFF, 0xFF, 0x00, 0xFF, 0xFF, 0x00, 0x01, 0x80,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 0x00, 0x00   // Code for char 
        };


void i2c_int(void)
{
	SIM->SCGC |=	(1<<17);									/*	turn	on	clock	to	I2C1*/
  SIM->PINSEL |= (1<<5);
	I2C0->C1 |= 0;
	I2C0->S	=	0x02;																/*	Clear	interrupt	flag	*/
  I2C0->F	=	0X0F;//0x1C;													/*	set	clock	to	97.09KHz	@13.981MHz	bus	clock	*/
  I2C0->C1	=	0x80;		
}

void i2c_start(void){
	int retry = 1000; 
    while (I2C0->S & 0x20) {    /* wait until bus is available */
        if (--retry <= 0)
        Delay(100);
    }
    /* send start */
    I2C0->C1 |= 0x10;    /* Tx on */
    I2C0->C1 |= 0x20;   

}

void i2c_start1(void){
	int retry = 1000; 
    while (I2C0->S & 0x20) {    /* wait until bus is available */
        if (--retry <= 0){
					break;}
				}
    /* send start */
    I2C0->C1 |= 0x10;    /* Tx on */
    I2C0->C1 |= 0x20;   

}

void i2c_add(char address, char RW) {
	    int retry = 2000;
	I2C0->D = (address << 1) | RW;         // Send the slave address with read/write bit

    //while (!(I2C0->S & 0x02));          // Wait for transfer complete
	while (!(I2C0->S & 0x02)) {
        if (--retry <= 0) {
            break; // timeout
        }
    }
    I2C0->S |= (1 << 1);               // Clear interrupt flag
    if (I2C0->S & 0x10) {             // Check for arbitration lost
        I2C0->S |= 0x10;             // Clear ARBL
    }
    if (I2C0->S & 0x01) {          // Check for NACK from slave
        // Handle NACK if needed
    }
}


void i2c_data(char data) {
		int retry = 200; 
    I2C0->D = data;  	// Send data
    while (I2C0->S & 0x20) {    /* wait until bus is available */
        if (--retry <= 0){
					break;}
				}
   // while (!(I2C0->S & 0x02));     // Wait for transfer complete
    I2C0->S |= 0x02;              // Clear interrupt flag
    if (I2C0->S & 0x01) {         // Check for NACK from slave

    }
}

void i2c_stop(void){
I2C0->C1 &= ~0x30;
}


void i2c_write(char address,char data[]){
uint16_t i=0;
i2c_start1();
i2c_add(address,0); 
	while(data[i]){
			i2c_data(data[i]);
			i++;
		}
	i2c_stop();
}

void oled_cmd_1byte(char data){
  i2c_int();
	i2c_start1();
	i2c_add(0x3C,0); //0x78 is the primary address
	i2c_data(0x00); // Control function for a command
	i2c_data(data);

	i2c_stop();
}
void oled_cmd_2byte(char data[]){
	int i = 0;
	i2c_int();
	i2c_start1();
	i2c_add(0x3C,0); //0x78 is the primary address
	i2c_data(0x00); // Control function for a command
	for (i=0;i<2;i++)
	{
		i2c_data(data[i]);
	}
	i2c_stop();
}

void oled_init(void){
	
		  char cmd[] = {0xA8,0x3F};
      char cmd1[] = {0xD3,0x00};
      char cmd2[] = {0xDA,0x22};//DA,22
      char cmd3[] = {0x81,0x7F};//81,7f
      char cmd4[] = {0xD5,0x80};
      char cmd5[] = {0x8D,0x14};
     // char cmd6[]= {0x20 ,0x20};//20 ,10,20
      //char cmd7[]= {0x26 ,0x2F};
			oled_cmd_1byte(0xAE);
			Delay(1);
      oled_cmd_2byte(cmd);
			      Delay(1);
      oled_cmd_2byte(cmd1);
			      Delay(1);
      oled_cmd_1byte(0x40);
					  Delay(1);
      oled_cmd_1byte(0xA1);
			Delay(1);
      oled_cmd_1byte(0xC8);
			Delay(1);
      oled_cmd_2byte(cmd2);
			Delay(1);
      oled_cmd_2byte(cmd3);
			Delay(1);
      oled_cmd_1byte(0xA6);
			Delay(1);
      oled_cmd_2byte(cmd4);
			Delay(1);
      oled_cmd_2byte(cmd5);
			Delay(1);
      oled_cmd_1byte(0xA4);
			Delay(1);
      oled_cmd_1byte(0xAF);
		/*	Delay(1);
      oled_cmd_2byte(cmd6);
      Delay(2);
     oled_cmd_2byte(cmd7);*/

}

void oled_data(char data)
{
	i2c_start1();
	i2c_add(0x3C,0); //0x78 is the primary address
	i2c_data(0x40); // Control function for a data
	i2c_data(data);
	i2c_stop();
}

void oled_pos(char Ypos, char Xpos){
	oled_cmd_1byte(0x00 + (0x0F & Xpos));
	oled_cmd_1byte(0x10 + (0x0F & (Xpos>>4)));
	oled_cmd_1byte(0xB0  + Ypos);
}
void oled_blank(void) {
    int i, j;
    oled_pos(0, 0); // Set initial position
	for (i = 0; i < 8; i++) { // Iterate through all 8 pages
       oled_pos(i, 0); // Set the column to 0 for each page
        for (j = 0; j < 129; j++) { // Iterate through all 128 columns
            oled_data(0x00); // Send 0x00 to turn off all pixels
        }
    }
}

void oled_clear_area(uint8_t page, uint8_t col, uint8_t width)
{
	uint8_t p=0,j=0;
    for(p = 0; p < VER_PAGE_REQ; p++)
    {
        oled_cmd_1byte(0xB0 + page + p);
        oled_cmd_1byte(0x00 + (col & 0x0F));
        oled_cmd_1byte(0x10 + ((col >> 4) & 0x0F));

        i2c_start1();
        i2c_add(0x3C, 0);
        i2c_data(0x40);

        for(j = 0; j < width; j++)
            i2c_data(0x00);

        i2c_stop();
    }
}


void Display_control_On(void) {
	oled_cmd_1byte(0x8D);  
	oled_cmd_1byte(0x14);  
	oled_cmd_1byte(0xAF);  
}
void Display_control_Off(void) {
	oled_cmd_1byte(0x8D);  
	oled_cmd_1byte(0x10);
	oled_cmd_1byte(0xAE);  
}

void print_char(char ch, char x_cord, char y_cord)
{
      char j=0,i=0;
	int array_index;
  char index = ch-32;
  int char_start_in_array  = index * NO_0F_BYTES_CHAR + 1;//no of bytes per row64
  if (ch < 32 || ch > 127) return;

  for ( j = x_cord; j < x_cord + HOR_COL_REQ ; j++)//horizontal 21
  {
    for ( i = y_cord; i < y_cord + VER_PAGE_REQ; i++)//vertical 3
    {
      oled_pos(i,j);
      array_index = char_start_in_array + (j - x_cord) * VER_PAGE_REQ + (i - y_cord);
                  oled_data(ASCII_16[array_index]);
			 //Delay(2);
			if (array_index < sizeof(ASCII_16))
                oled_data(ASCII_16[array_index]);
            else
                oled_data(0x00);  // Safe fallback
    }
  }
}




void draw_icon(const uint8_t *icon, char x, char y_page, char width, char pages) {
	char page=0,col=0;
    for ( page = 0; page < pages; page++) {
        oled_pos(y_page + page, x);  // Set position to (x, page)
        for ( col = 0; col < width; col++) {
            oled_data(icon[page * width + col]);  // Send each column byte
        }
    }
}




/*void print_string(char *s,char x,char y,int length)
{
	int i;
	char x_cord=0;
       for(i=0; i< length;i++)
       {
             char ch  = s[i];
		
             x_cord = x+ i* (HOR_COL_REQ-6);
             
             print_char(ch,x_cord,y);
				 
				 	 if(ch=='W'||ch=='w'){
					 x_cord = x+ i* (HOR_COL_REQ-2);
				 }
        }
			}*/
			
void print_string(char *s, char x, char y, int length)
{
    int i;
    int x_pos = x;  // running horizontal position

    for(i = 0; i < length; i++)
    {
        char ch = s[i];

        // Print the character at current position
        print_char(ch, x_pos, y);

        // Update x_pos for next character
        if(ch == 'W' || ch == 'w'||ch=='M' || ch=='m') {
            x_pos += HOR_COL_REQ ;  // extra spacing after W
        } else {
            x_pos += HOR_COL_REQ - 7;  // normal spacing
        }
    }
}

// Turn on the entire display first, then clear from center vertically
/*void oled_vertical_clear_center(uint16_t delay_ms)
{
    uint8_t page, col;
	    // 2?? Now clear from the vertical center
    int left  = 63; // center columns
    int right = 64;

    // 1?? Fill the entire display (all pixels ON)
    for (page = 0; page < 8; page++) // 8 pages for 64 rows (8 rows per page)
    {
        for (col = 0; col < 128; col++)
        {
            oled_pos(page, col);
            oled_data(0xFF); // Turn all pixels ON
        }
    }


    while (left >= 0 || right < 128)
    {
        for (page = 0; page < 8; page++)
        {
            if (left >= 0)
            {
                oled_pos(page, left);
                oled_data(0x00); // Clear pixel
            }

            if (right < 128)
            {
                oled_pos(page, right);
                oled_data(0x00); // Clear pixel
            }
        }

        Delay(delay_ms); // Wait between steps
        left--;
        right++;
    }
}
// Turn ON entire display, then clear from LEFT to RIGHT
void oled_vertical_clear_left_to_right(void)
{
    uint8_t page, col;

    // 2?? Clear columns from LEFT to RIGHT
    for (col = 0; col < 128; col++)
    {
        for (page = 0; page < 8; page++)
        {
            oled_pos(page, col);
            oled_data(0x00);
        }
    }
}*/

